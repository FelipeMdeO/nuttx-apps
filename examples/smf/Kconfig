## examples/smf/Kconfig
```kconfig
#
# For a description of the syntax of this configuration file,
# see the file kconfig-language.txt in the NuttX tools repository.
#

config EXAMPLES_SMF
  tristate "State Machine Framework PSICC2 demo (HSM)"
  default n
  select NSH_BUILTIN_APPS
  select SYSTEM_SMF
  select SYSTEM_SMF_ANCESTOR_SUPPORT
  select SYSTEM_SMF_INITIAL_TRANSITION

if EXAMPLES_SMF

config EXAMPLES_SMF_PROGNAME
  string "Program name"
  default "hsm_psicc2"

config EXAMPLES_SMF_PRIORITY
  int "Priority"
  default 100

config EXAMPLES_SMF_STACKSIZE
  int "Stack size"
  default 2048

config EXAMPLES_SMF_EVENT_QUEUE_SIZE
  int "Event queue size"
  default 10

config EXAMPLES_SMF_MQ_NAME
  string "Message queue name"
  default "/hsm_psicc2_mq"

endif
```

## satelital/Kconfig
```kconfig
#
# For a description of the syntax of this configuration file,
# see the file kconfig-language.txt in the NuttX tools repository.
#
menu "Satelital"

menuconfig  SATELITAL_STX_MODULE
	tristate "Global Star STX3 Satellite Module"
	default n

config SATELITAL_STX_MODULE
	---help---
	The STX3 Satellite Module offers robust satellite
	connectivity through Globalstar's advanced STX3 technology. Designed
	for reliable communication in remote and challenging environments,
	this module enables seamless data transmission and reception between
	the device and Globalstar's satellite network. It supports UART
	communication protocols, ensuring compatibility and flexibility for
	various applications such as IoT devices, asset tracking, and remote
	monitoring systems. The STX3 module utilizes efficient power
	management and secure data transfer methods to maintain continuous
	and dependable satellite connections, making it an essential component
	for enhancing connectivity in areas with limited or no terrestrial
	network coverage.

if SATELITAL_STX_MODULE

config SATELITAL_STX_MODULE_PROGNAME
	string "Program name"
	default "stx3"
	---help---
		This is the name of the program that will be used when the NSH ELF
		program is installed.

config SATELITAL_STX_MODULE_PRIORITY
	int  "Task priority"
	default 100

config SATELITAL_STX_MODULE_STACKSIZE
	int "Stack size"
	default DEFAULT_TASK_STACKSIZE
	
config STX3_RTS_DEVNAME
	string "rts gpio device name"
	default "/dev/gpio0"
	---help---
		Select the device name for the rts pin of the STX3 Satellite Module.
	
config STX3_CTS_DEVNAME
	string "cts gpio device name"
	default "/dev/gpio1"
	---help---
		Select the device name for the cts pin of the STX3 Satellite Module.

config STX3_RESET_DEVNAME
	string "reset gpio device name"
	default "/dev/gpio2"
	---help---
		Select the device name for the reset pin of the STX3 Satellite Module.


config STX3_UART_DEVNAME
	string "uart device name"
	default "/dev/ttyS1"
	---help---
		Select the device name for the UART of the STX3 Satellite Module.

config STX3_CHANNEL
	int "Channel"
	default 2
	---help---
		Select the channel to use with the STX3 Satellite Module. (default 2)
		0 = Channel A
		1 = Channel B
		2 = Channel C
		3 = Channel D

config STX_NUM_BURSTS
	int "Number of bursts"
	default 3
	---help---
		Select the number of bursts to use with the STX3 Satellite Module. (default 3)

config STX3_MIN_INTERVAL
	int "Minimum interval"
	default 60
	---help---
		Select the minimum interval to use with the STX3 Satellite Module.
		60 x 5 = 300 seconds = 5 minutes

config STX3_MAX_INTERVAL
	int "Maximum interval"
	default 120
	---help---
		Select the maximum interval to use with the STX3 Satellite Module.
		120 x 5 = 600 seconds = 10 minutes

endif

endmenu
```

## system/smf/Kconfig
```kconfig
# SMF (State Machine Framework) configuration options
#
# For syntax reference, see kconfig-language.txt in the NuttX tools repository.

config APPS_SMF
  bool "(SMF) support"
  default n
  ---help---
    Enables the State Machine Framework (SMF) for implementing state machines

if APPS_SMF

config SMF_ANCESTOR_SUPPORT
	bool "Enable ancestor/parent state support"
	default n
	---help---
	  Enables support for parent/ancestor relationships between SMF states.
	  Required for hierarchical state machines.

config SMF_INITIAL_TRANSITION
	bool "Enable initial transition support"
	default n
	depends on SMF_ANCESTOR_SUPPORT
	---help---
	  Enables support for initial transitions in hierarchical states.
	  Depends on ancestor/parent state support.

endif # APPS_SMF
```
