## examples/imu_logger/Kconfig
```kconfig
#
# For a description of the syntax of this configuration file,
# see the file kconfig-language.txt in the NuttX tools repository.
#

config EXAMPLES_IMU_LOGGER
	bool "IMU CSV logger"
	default n
	depends on SENSORS_MPU6050 && UORB && INPUT_BUTTONS
	---help---
		Subscribe to the accelerometer and gyroscope uORB topics published
		by the MPU6050 driver and log them to CSV files, one row per
		sample, toggled on and off by a button press.  Meant to collect
		motion gesture datasets for training an on-device model.

if EXAMPLES_IMU_LOGGER

config EXAMPLES_IMU_LOGGER_FREQUENCY
	int "Sampling frequency in Hz"
	default 25
	range 1 100
	---help---
		Frequency requested from both topics while recording.  The
		MPU6050 driver configures the device for 100 Hz, so higher
		values will repeat samples.

config EXAMPLES_IMU_LOGGER_MOUNTPOINT
	string "Directory where CSV files are written"
	default "/data"
	---help---
		Must already be mounted on a writable filesystem, e.g. the
		littlefs volume set up by board_spiflash_init().

config EXAMPLES_IMU_LOGGER_BUTTON_DEVPATH
	string "Button device path"
	default "/dev/buttons"

config EXAMPLES_IMU_LOGGER_BUTTON_MASK
	hex "Button bitmask that toggles recording"
	default 0x1
	---help---
		Matched against the buttonset read from
		EXAMPLES_IMU_LOGGER_BUTTON_DEVPATH.  The default is BOOT on the
		esp32s3-devkit, the only button board_buttons() reports there.

config EXAMPLES_IMU_LOGGER_LED_DEVPATH
	string "Status LED device path (empty to disable)"
	default "/dev/leds0"
	---help---
		A ws2812-compatible RGB LED device, lit green while recording and
		red otherwise.  Leave empty to skip the status LED entirely; a
		device that fails to open is also just skipped.

config EXAMPLES_IMU_LOGGER_PROGNAME
	string "Program name"
	default "imu_logger"
	---help---
		This is the name of the program that will be used when the NSH
		ELF program is installed.

config EXAMPLES_IMU_LOGGER_PRIORITY
	int "IMU logger task priority"
	default 100

config EXAMPLES_IMU_LOGGER_STACKSIZE
	int "IMU logger stack size"
	default 4096
	---help---
		fopen()/fprintf() on a littlefs file, six floating point %.6f
		conversions per CSV row and the uORB subscriptions together do
		not fit in DEFAULT_TASK_STACKSIZE (2048): the overflow does not
		fail cleanly, it corrupts memory outside the task and the crash
		surfaces in an unrelated kernel primitive (observed: a
		LoadProhibited fault inside nxsem_wait()).

endif
```

## examples/mpu6050/Kconfig
```kconfig
#
# For a description of the syntax of this configuration file,
# see the file kconfig-language.txt in the NuttX tools repository.
#

config EXAMPLES_MPU6050
	bool "MPU6050 uORB example"
	default n
	depends on SENSORS_MPU6050 && UORB
	---help---
		Subscribe to the accelerometer and gyroscope uORB topics
		published by the MPU6050 driver and print the six axes.

if EXAMPLES_MPU6050

config EXAMPLES_MPU6050_SAMPLES
	int "Number of samples to acquire"
	default 20
	---help---
		Default number of samples to print before exiting.  Zero runs
		until the task is killed.  It can be overridden by the first
		command line argument.

config EXAMPLES_MPU6050_FREQUENCY
	int "Sampling frequency in Hz"
	default 10
	range 1 1000
	---help---
		Frequency requested from both topics.  The MPU6050 driver
		configures the device for 100 Hz, so higher values will repeat
		samples.

config EXAMPLES_MPU6050_PROGNAME
	string "Program name"
	default "mpu6050"
	---help---
		This is the name of the program that will be used when the NSH
		ELF program is installed.

config EXAMPLES_MPU6050_PRIORITY
	int "MPU6050 example task priority"
	default 100

config EXAMPLES_MPU6050_STACKSIZE
	int "MPU6050 example stack size"
	default DEFAULT_TASK_STACKSIZE

endif
```

## examples/sensor_fusion/Kconfig
```kconfig
#
# For a description of the syntax of this configuration file,
# see the file kconfig-language.txt in the NuttX tools repository.
#

config EXAMPLES_SENSOR_FUSION
	bool "Sensor Fusion Example"
	default n
	depends on UORB
	---help---
		Sensor fusion example that combines the accelerometer and gyroscope
		uORB topics using the Madgwick algorithm to provide yaw, pitch and
		roll angles.

		The Fusion library implementing the algorithm is downloaded at build
		time from https://github.com/xioTechnologies/Fusion, so network
		access is required when configuring this example.

if EXAMPLES_SENSOR_FUSION

config EXAMPLES_SENSOR_FUSION_SAMPLES
	int "Number of samples to acquire"
	default 100
	---help---
		Default number of samples to print before exiting.  Zero runs until
		the task is killed.  It can be overridden by the first command line
		argument.

config EXAMPLES_SENSOR_FUSION_SAMPLE_RATE
	int "Sample rate in ms"
	default 100
	range 1 1000

config EXAMPLES_SENSOR_FUSION_PROGNAME
	string "Program name"
	default "sensor_fusion"
	---help---
		This is the name of the program that will be used when the NSH ELF
		program is installed.

config EXAMPLES_SENSOR_FUSION_PRIORITY
	int "Sensor Fusion task priority"
	default 100

config EXAMPLES_SENSOR_FUSION_STACKSIZE
	int "Sensor Fusion stack size"
	default DEFAULT_TASK_STACKSIZE

endif
```

## mlearning/tflm/Kconfig
```kconfig
#
# For a description of the syntax of this configuration file,
# see the file kconfig-language.txt in the NuttX tools repository.
#

menuconfig TFLITE_MICRO
	bool "TensorFlow Lite Micro"
	default n
	depends on HAVE_CXX
	---help---
		Enable TensorFlow Lite for Microcontrollers (TFLM), an inference
		engine for running machine learning models on microcontrollers.
		The source tree is imported from tensorflow/tflite-micro upstream
		(see scripts/sync_from_tflite_micro.sh).

if TFLITE_MICRO

config TFLITE_MICRO_ARENA_SIZE
	int "Tensor arena size (bytes)"
	default 65536
	---help---
		Default size of the tensor arena (static working memory) used by
		applications. Individual applications may override this value.

choice
	prompt "TFLM kernel backend"
	default TFLITE_MICRO_KERNEL_REFERENCE
	---help---
		Kernel implementation used by the interpreter. Only the portable
		reference kernels are available for now; architecture-optimized
		backends may be added later as opt-in specializations.

config TFLITE_MICRO_KERNEL_REFERENCE
	bool "Reference kernels (portable, unoptimized)"

endchoice

endif # TFLITE_MICRO
```
